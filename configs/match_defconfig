## configs/match_defconfig
```kconfig
BR2_arm=y
BR2_GLOBAL_PATCH_DIR="board/nuvoton/match/patches"
BR2_TOOLCHAIN_BUILDROOT_VENDOR="nuvoton"
BR2_PACKAGE_HOST_LINUX_HEADERS_CUSTOM_4_4=y
BR2_UCLIBC_CONFIG="board/nuvoton/uClibc-nuc980.config"
BR2_TOOLCHAIN_BUILDROOT_INET_RPC=y
BR2_TOOLCHAIN_BUILDROOT_LOCALE=y
BR2_GCC_VERSION_4_8_X=y
BR2_TOOLCHAIN_BUILDROOT_CXX=y
BR2_PACKAGE_HOST_GDB=y
BR2_ROOTFS_DEVICE_CREATION_DYNAMIC_MDEV=y
# BR2_TARGET_ENABLE_ROOT_LOGIN is not set
# BR2_TARGET_GENERIC_GETTY is not set
BR2_ROOTFS_OVERLAY="overlay/"
BR2_ROOTFS_POST_BUILD_SCRIPT="board/nuvoton/install_nuc980_iot.sh"
BR2_LINUX_KERNEL=y
BR2_LINUX_KERNEL_CUSTOM_GIT=y
BR2_LINUX_KERNEL_CUSTOM_REPO_URL="https://github.com/OpenNuvoton/NUC980-linux-4.4.y.git"
BR2_LINUX_KERNEL_CUSTOM_REPO_VERSION="master"
BR2_LINUX_KERNEL_DEFCONFIG="nuc980_iot"
BR2_LINUX_KERNEL_UIMAGE=y
BR2_PACKAGE_APPLICATIONS=y
NUC980_APPLICATIONS=y
NUC980_APPLICATIONS_BUILD_DEMOS=y
NUC980_APPLICATIONS_BUILD_YAFFS2UTILS=y
BR2_PACKAGE_BUSYBOX_CONFIG="board/nuvoton/busybox-nuc980.config"
BR2_PACKAGE_BZIP2=y
BR2_PACKAGE_ZIP=y
BR2_PACKAGE_GETTEXT=y
BR2_PACKAGE_GIT=y
BR2_PACKAGE_PHP=y
BR2_PACKAGE_PHP_EXT_SQLITE=y
BR2_PACKAGE_OPENSSL=y
BR2_PACKAGE_NCURSES=y
BR2_PACKAGE_NCURSES_TARGET_PANEL=y
BR2_PACKAGE_NCURSES_TARGET_FORM=y
BR2_PACKAGE_NCURSES_TARGET_MENU=y
BR2_PACKAGE_LIGHTTPD=y
BR2_PACKAGE_NMAP=y
BR2_PACKAGE_NTP=y
BR2_PACKAGE_NTP_NTPDATE=y
BR2_PACKAGE_PPPD=y
BR2_TARGET_ROOTFS_INITRAMFS=y
BR2_TARGET_UBOOT=y
BR2_TARGET_UBOOT_BUILD_SYSTEM_KCONFIG=y
BR2_TARGET_UBOOT_CUSTOM_GIT=y
BR2_TARGET_UBOOT_CUSTOM_REPO_URL="https://github.com/OpenNuvoton/NUC970_U-Boot_v2016.11.git"
BR2_TARGET_UBOOT_CUSTOM_REPO_VERSION="master"
BR2_TARGET_UBOOT_BOARD_DEFCONFIG="nuc980_iot"
BR2_TARGET_UBOOT_SPL=y
```
